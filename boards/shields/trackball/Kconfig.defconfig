## boards/shields/trackball/Kconfig.defconfig
```kconfig
if SHIELD_TRACKBALL

config ZMK_KEYBOARD_NAME
    default "Trackball Macro"

endif
```

## config/west.yml
```yaml
manifest:
  defaults:
    revision: v0.3
  remotes:
    - name: zmkfirmware
      url-base: https://github.com/zmkfirmware
    - name: elpekenin
      url-base: https://github.com/elpekenin
    - name: MickiusMousius
      url-base: https://github.com/MickiusMousius
    - name: badjeff
      url-base: https://github.com/badjeff
    # Additional modules containing boards/shields/custom code can be listed here as well
    # See https://docs.zephyrproject.org/3.2.0/develop/west/manifest.html#projects
  projects:
    - name: zmk
      remote: zmkfirmware
      import: app/west.yml
    - name: zmk-userspace
      remote: elpekenin
      revision: main
    - name: zmk-ls0xxvcom-driver
      remote: MickiusMousius
      revision: main
    - name: zmk-analog-input-driver
      remote: badjeff
      revision: main
    - name: zmk-adns9800-driver
      remote: badjeff
      revision: main
  self:
    path: config
```
